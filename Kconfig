## Kconfig
```kconfig
config TRAVELERS_PAD_XIAO_BOOT_PROBE
    bool "XIAO USB boot diagnostic"
    default n
    depends on ZMK_USB
    help
      Diagnostic-only startup indicator for distinguishing a missing USB
      enumeration from a failed transition out of the UF2 bootloader.

config TRAVELERS_PAD_BLE_IDLE_HISTORY
    bool "RAM-only BLE idle diagnostic history"
    default n
    depends on ZMK_BLE && ZMK_USB_LOGGING && SOC_NRF52840_QIAA
    help
      Retain eight minutes of RDY/input/BLE/workqueue snapshots in RAM and
      dump them when a USB serial monitor reconnects. Diagnostic only; no
      reset, sensor register access, persistent storage or HID output.
```

## boards/shields/iqs9150_xiao/Kconfig.defconfig
```kconfig
if SHIELD_IQS9150_XIAO

config ZMK_KEYBOARD_NAME
    default "IQS9150 EV02"

endif
```

## config/west.yml
```yaml
manifest:
  remotes:
    - name: zmkfirmware
      url-base: https://github.com/zmkfirmware
    - name: amgskobo
      url-base: https://github.com/amgskobo
    - name: caksoylar
      url-base: https://github.com/caksoylar
  projects:
    - name: zmk-rgbled-widget
      remote: caksoylar
      revision: v0.3-branch
      path: module/zmk-rgbled-widget
    # Private module repositories; authenticated Git access is required.
    # private module取得には認証済みGitアクセスが必要。
    - name: zmk-driver-iqs9150
      url: https://github.com/taichan1113/zmk-driver-iqs9150.git
      revision: stable-2026-11-08
      path: module/zmk-driver-iqs9150
    - name: zmk-features-trackpad
      url: https://github.com/taichan1113/zmk-features-trackpad.git
      revision: stable-2026-11-08
      path: module/zmk-features-trackpad
    - name: zmk
      remote: zmkfirmware
      revision: v0.3
      import: app/west.yml
    - name: zmk-input-matrix
      remote: amgskobo
      revision: 1a65e503905dd31e0c907b4ec3bfafb76c3d18ec
      path: module/zmk-input-matrix
  self:
    path: config
```

## dts/bindings/input/azoteq,iqs9150.yaml
```yaml
description: Azoteq IQS9150 capacitive trackpad controller

compatible: "azoteq,iqs9150"

include: i2c-device.yaml

properties:
  rdy-gpios:
    type: phandle-array
    required: true
    description: |
      GPIO connected to the IQS9150 RDY output. RDY is active-low and
      open-drain. Put pull-up flags here only when the EV02 board does not
      provide the required external pull-up.
```

## dts/bindings/input/zmk,travelers-pad-iqs9150-edge-hold-continue.yaml
```yaml
description: Travelers Pad IQS9150 edge-hold continuation function

compatible: "zmk,travelers-pad-iqs9150-edge-hold-continue"

include: base.yaml

properties:
  drag-input-device:
    type: phandle
    required: true
    description: Raw IQS9150 contact stream used while a confirmed drag is active
  scroll-input-device:
    type: phandle
    required: true
    description: Router output stream used only after two-finger scroll is committed
  surface-x:
    type: int
    default: 2000
    description: Usable pad width in IQS9150 absolute coordinates
  surface-y:
    type: int
    default: 1213
    description: Usable pad height in IQS9150 absolute coordinates
  edge-size:
    type: int
    default: 80
    description: Width of the physical boundary zone that arms continuation detection
  drag-start-delay-ms:
    type: int
    default: 120
    description: Hold time at an edge before virtual drag motion begins
  drag-repeat-ms:
    type: int
    default: 24
    description: Period of virtual drag motion while an edge remains held
  drag-repeat-delta:
    type: int
    default: 8
    description: Relative-coordinate delta emitted on each virtual drag-motion period
```

## dts/bindings/input/zmk,travelers-pad-iqs9150-multifinger-router.yaml
```yaml
description: Travelers Pad IQS9150 exclusive multi-finger gesture router

compatible: "zmk,travelers-pad-iqs9150-multifinger-router"

include: base.yaml

properties:
  input-device:
    type: phandle
    required: true
    description: Raw IQS9150 contact input device
  scroll-classify-move:
    type: int
    default: 35
    description: Minimum movement required from each direction-coherent contact before committing two-finger scroll
  geometry-distance-threshold:
    type: int
    default: 30000
    description: Squared-distance change that claims pinch geometry
  geometry-rotation-threshold:
    type: int
    default: 30000
    description: Cross-product magnitude that claims rotation geometry
```

## dts/bindings/input/zmk,travelers-pad-iqs9150-pointer.yaml
```yaml
description: Travelers Pad IQS9150 pointer and scroll function

compatible: "zmk,travelers-pad-iqs9150-pointer"

include: base.yaml

properties:
  input-device:
    type: phandle
    required: true
    description: IQS9150 raw contact input device
  scroll-divisor:
    type: int
    default: 4
    description: Divide accumulated two-finger coordinate deltas before wheel output
  scroll-axis-lock-min-move:
    type: int
    default: 12
    description: >
      Accumulated coordinate movement required before locking a two-finger
      scroll axis. 2本指スクロールの軸を決定するまでに蓄積する座標移動量。
  scroll-axis-lock-ratio:
    type: int
    default: 2
    description: >
      Horizontal-to-vertical ratio required to choose horizontal scrolling;
      otherwise vertical is selected. 横スクロールを選ぶために必要な横/縦移動比。
      それ以外は縦スクロールを選ぶ。
  scroll-max-frame-delta:
    type: int
    default: 128
    description: >
      Per-frame coordinate delta above which a scroll frame is discarded and
      rebased. この値を超える1フレーム差分は破棄して座標基準を更新する。
  scroll-invert-vertical:
    type: boolean
    description: >
      Reverse the vertical two-finger scroll direction. This is a keyboard
      configuration option; omitted means the standard direction. 2本指の
      縦スクロール方向を反転する。省略時は標準方向となるキーボード設定項目。
  scroll-invert-horizontal:
    type: boolean
    description: >
      Reverse the horizontal two-finger scroll direction. This is a keyboard
      configuration option; omitted means the standard direction. 2本指の
      横スクロール方向を反転する。省略時は標準方向となるキーボード設定項目。
```

## dts/bindings/input/zmk,travelers-pad-iqs9150-transform-gesture.yaml
```yaml
description: Travelers Pad IQS9150 two-finger pinch and rotation primary recognizer

compatible: "zmk,travelers-pad-iqs9150-transform-gesture"

include: base.yaml

properties:
  input-device:
    type: phandle
    required: true
    description: Normalized contact-session input device
  distance-threshold:
    type: int
    default: 30000
    description: Squared-distance change required to classify a pinch
  rotation-threshold:
    type: int
    default: 30000
    description: Cross-product magnitude required to classify a rotation
```

## dts/bindings/input/zmk,travelers-pad-scroll-inertia.yaml
```yaml
description: Travelers Pad two-finger scroll inertia function

compatible: "zmk,travelers-pad-scroll-inertia"

include: base.yaml

properties:
  contact-input-device:
    type: phandle
    required: true
    description: Raw IQS9150 stream used to identify physical contact release
  wheel-input-device:
    type: phandle
    required: true
    description: Canonical wheel stream emitted by the pointer function
  wheel-output-device:
    type: phandle
    required: true
    description: Pointer device used to re-enter the normal wheel listener chain
  start-delay-ms:
    type: int
    default: 20
    description: Delay after two-finger release before inertia begins
  repeat-ms:
    type: int
    default: 24
    description: Period between inertia wheel reports
  decay-numerator:
    type: int
    default: 3
    description: Numerator of per-report velocity decay
  decay-denominator:
    type: int
    default: 4
    description: Denominator of per-report velocity decay
  stop-delta:
    type: int
    default: 2
    description: Absolute raw wheel delta below which inertia stops
  max-delta:
    type: int
    default: 64
    description: Maximum absolute raw wheel delta accepted from one physical report
```

## dts/bindings/input_processors/zmk,travelers-pad-management-gate.yaml
```yaml
description: Keyboard-local layer gate for management grid and host mouse output
compatible: "zmk,travelers-pad-management-gate"
include: ip_zero_param.yaml
properties:
  layer:
    type: int
    required: true
  grid-only:
    type: boolean
```

## dts/bindings/input_processors/zmk,travelers-pad-scroll-acceleration.yaml
```yaml
description: Travelers Pad speed-based two-finger scroll acceleration processor

compatible: "zmk,travelers-pad-scroll-acceleration"

include: ip_zero_param.yaml

properties:
  fast-threshold:
    type: int
    default: 12
    description: Absolute wheel delta at or above which fast multiplier is applied
  fast-multiplier:
    type: int
    default: 2
    description: Multiplier applied to fast wheel deltas
```

## dts/bindings/kscan/zmk,travelers-pad-iqs9150-edge-dial-kscan.yaml
```yaml
description: Travelers Pad IQS9150 continuous edge-trace virtual KSCAN
compatible: "zmk,travelers-pad-iqs9150-edge-dial-kscan"
include: [kscan.yaml, base.yaml]
properties:
  rows:
    type: int
    required: true
  columns:
    type: int
    required: true
  input-device:
    type: phandle
    required: true
  surface-x:
    type: int
    default: 2000
  surface-y:
    type: int
    default: 1213
  edge-size:
    type: int
    default: 140
  step-move:
    type: int
    default: 80
  circle-entry-depth:
    type: int
    default: 80
  circle-entry-span:
    type: int
    default: 250
  circle-step-move:
    type: int
    default: 80
  circle-center-x:
    type: int
    description: Optional centre X coordinate; omit to use surface centre.
  circle-center-y:
    type: int
    description: Optional centre Y coordinate; omit to use surface centre.
  edge-left:
    type: boolean
  edge-right:
    type: boolean
  edge-top:
    type: boolean
  edge-bottom:
    type: boolean
```

## dts/bindings/kscan/zmk,travelers-pad-iqs9150-grid-kscan.yaml
```yaml
description: Travelers Pad IQS9150 grid and edge gesture virtual KSCAN

compatible: "zmk,travelers-pad-iqs9150-grid-kscan"

include: [kscan.yaml, base.yaml]

properties:
  input-device:
    type: phandle
    required: true
    description: IQS9150 raw contact input device
  rows:
    type: int
    required: true
  columns:
    type: int
    required: true
  surface-x:
    type: int
    default: 2000
  surface-y:
    type: int
    default: 1213
  edge-size:
    type: int
    default: 0
    description: Width of enabled edge zones in sensor coordinate units
  edge-keys:
    type: array
    required: false
    description: Eight cells, left/right/top/bottom as row,column pairs
  edge-left:
    type: boolean
    description: Enable the left edge
  edge-right:
    type: boolean
    description: Enable the right edge
  edge-top:
    type: boolean
    description: Enable the top edge
  edge-bottom:
    type: boolean
    description: Enable the bottom edge
  edges-only:
    type: boolean
    description: Ignore taps outside enabled edges instead of falling back to the grid
  tap-max-ms:
    type: int
    default: 350
  tap-max-move:
    type: int
    default: 75
```
