&iqs9150 {
    /delete-property/ diagnostic-disable-mode-timeouts;
    /delete-property/ diagnostic-disable-lp-entry;
    /delete-property/ diagnostic-disable-alp;
    power-mode-limit = "none";
    power-diagnostics;
    diagnostic-disable-lp2-autoprox;
};
